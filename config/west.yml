## config/west.yml
```yaml
manifest:
  remotes:
    - name: zmkfirmware
      url-base: https://github.com/zmkfirmware
    # nice_oled
    # - name: mctechnology17
      # url-base: https://github.com/mctechnology17
  projects:
    - name: zmk
      remote: zmkfirmware
      # Pin to a stable ZMK release so CI does not break when upstream `main`
      # introduces incompatible changes.
      revision: v0.3.0
      import: app/west.yml
    # nice_oled
    # - name: zmk-nice-oled

      # remote: mctechnology17
      # revision: main
  self:
    path: config
```
